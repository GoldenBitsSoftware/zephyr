## lib/auth/Kconfig
```kconfig
# SPDX-License-Identifier: Apache-2.0



menuconfig AUTH_LIB
	bool "Authentication library"
	help
	  This option enables the Authentication library.

if AUTH_LIB
	config AUTH_CHALLENGE_RESPONSE
		bool "Challenge Response (Must use TINYCRYPT and TINYCRYPT_SHA256)"
		help
		Selects the Challenge Response authentication method.
		Must use TINYCRYPT and TINYCRYPT_SHA256

	config AUTH_DTLS
		bool "DTLS Authentication"
		help
		Selects the DTLS authentication method.

    config AUTH_LOG_LEVEL
        int "Authentication log level"
        depends on LOG
        range 0 4
        default 0
        help
          Sets authentication log level
          Levels are:
          0 OFF, do not write
          1 ERROR, only write LOG_ERR
          2 WARNING, write LOG_WRN in addition to previous level
          3 INFO, write LOG_INF in addition to previous levels
          4 DEBUG, write LOG_DBG in addition to previous levels


    config AUTH_FRAGMENT
		bool "Fragment messages"
		help
		Used to break up messages into smaller chunks over the lower transport.
		For example, a 60 byte message send over a Bluetooth link with a 23 byte
		MTU would be broken into three fragments of sizes 23, 23, and 14.
		If not set, then the messages are sent and received as a byte stream with
		no message boundary.

    config BT_XPORT
		bool "Bluetooth Transport"
		help
		If using Bluetooth to authenticate peer.

    config SERIAL_XPORT
		bool "Serial Transport"
		help
		If using serial port to authenticate peer.


	config NUM_AUTH_INSTANCES
	    int "Number of authentication instances"
	    range 1 2
	    default 1
	    help
	    Each authentication instance uses a thread to authenticate with
	    a peer over the lower transport.  It is possible to have multiple
	    authentication instances where one instance authenticates a peer
	    over Bluetooth and another authenticates over a serial link.  Another example
	    would be a Bluetooth Central needing to authenticate multiple
	    connected Peripherals.



endif
```

## subsys/bluetooth/services/Kconfig.auths
```kconfig
# Bluetooth GATT Authentication Service

# SPDX-License-Identifier: Apache-2.0

menuconfig BT_GATT_AUTHS
	bool "Enable GATT Authentication service"
	default n

if BT_GATT_AUTHS

config BT_GATT_AUTHS_LOG_LEVEL
	int "Authentication service log level"
	depends on LOG
	range 0 4
	default 0
	help
	  Sets log level for the Heart Rate service.
	  Levels are:
	  0 OFF, do not write
	  1 ERROR, only write LOG_ERR
	  2 WARNING, write LOG_WRN in addition to previous level
	  3 INFO, write LOG_INF in addition to previous levels
	  4 DEBUG, write LOG_DBG in addition to previous levels

endif # BT_GATT_AUTHS
```

## tests/lib/authentication/testcase.yaml
```yaml
tests:
  authentication.auth:
    tags: authentication
    platform_whitelist: qemu_cortex_m3 qemu_x86
```
